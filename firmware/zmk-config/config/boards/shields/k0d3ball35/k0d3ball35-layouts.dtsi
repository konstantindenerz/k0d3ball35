/*
 * Physical layout of k0d3ball35. Generated by scripts/gen_physical_layout.py
 * from hardware/layout/output/points-left.json and points-right.json; do not
 * edit by hand.
 *
 * Key order equals the matrix transform order: three finger rows (left pinky
 * to left inner, then right inner to right pinky) followed by the five thumb
 * keys (left outer, middle, inner; right inner, middle - the right half has no
 * outer thumb key since r2.3, the ball pocket is there). 35 keys.
 */

#include <physical_layouts.dtsi>

= <&key_physical_attrs  100   94     0    58       0     0     0>
            , <&key_physical_attrs  100   94   100    23       0     0     0>
            , <&key_physical_attrs  100   94   200     0       0     0     0>
            , <&key_physical_attrs  100   94   300    12       0     0     0>
            , <&key_physical_attrs  100   94   400    25       0     0     0>
            , <&key_physical_attrs  100   94   800    25       0     0     0>
            , <&key_physical_attrs  100   94   900    12       0     0     0>
            , <&key_physical_attrs  100   94  1000     0       0     0     0>
            , <&key_physical_attrs  100   94  1100    23       0     0     0>
            , <&key_physical_attrs  100   94  1200    58       0     0     0>
            , <&key_physical_attrs  100   94     0   152       0     0     0>
            , <&key_physical_attrs  100   94   100   118       0     0     0>
            , <&key_physical_attrs  100   94   200    94       0     0     0>
            , <&key_physical_attrs  100   94   300   107       0     0     0>
            , <&key_physical_attrs  100   94   400   119       0     0     0>
            , <&key_physical_attrs  100   94   800   119       0     0     0>
            , <&key_physical_attrs  100   94   900   107       0     0     0>
            , <&key_physical_attrs  100   94  1000    94       0     0     0>
            , <&key_physical_attrs  100   94  1100   118       0     0     0>
            , <&key_physical_attrs  100   94  1200   152       0     0     0>
            , <&key_physical_attrs  100   94     0   247       0     0     0>
            , <&key_physical_attrs  100   94   100   212       0     0     0>
            , <&key_physical_attrs  100   94   200   189       0     0     0>
            , <&key_physical_attrs  100   94   300   201       0     0     0>
            , <&key_physical_attrs  100   94   400   214       0     0     0>
            , <&key_physical_attrs  100   94   800   214       0     0     0>
            , <&key_physical_attrs  100   94   900   201       0     0     0>
            , <&key_physical_attrs  100   94  1000   189       0     0     0>
            , <&key_physical_attrs  100   94  1100   212       0     0     0>
            , <&key_physical_attrs  100   94  1200   247       0     0     0>
            , <&key_physical_attrs  100   94   321   331       0     0     0>
            , <&key_physical_attrs  100   94   434   340    1000   484   388>
            , <&key_physical_attrs  100   94   544   368    2000   594   415>
            , <&key_physical_attrs  100   94   656   368 (-2000)   706   415>
            , <&key_physical_attrs  100   94   766   340 (-1000)   816   388>
            ;
