## firmware/zmk-config/config/boards/shields/k0d3ball35/Kconfig.shield
```kconfig
# SPDX-License-Identifier: MIT

config SHIELD_K0D3BALL35_LEFT
    def_bool $(shields_list_contains,k0d3ball35_left)

config SHIELD_K0D3BALL35_RIGHT
    def_bool $(shields_list_contains,k0d3ball35_right)
```

## firmware/zmk-config/config/boards/shields/k0d3ball36/Kconfig.shield
```kconfig
# SPDX-License-Identifier: MIT

config SHIELD_K0D3BALL36_LEFT
    def_bool $(shields_list_contains,k0d3ball36_left)

config SHIELD_K0D3BALL36_RIGHT
    def_bool $(shields_list_contains,k0d3ball36_right)
```
